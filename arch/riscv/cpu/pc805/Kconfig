## arch/riscv/cpu/pc805/Kconfig
```kconfig
config RISCV_PICOCOM
	bool
	select ARCH_EARLY_INIT_R
	imply CPU
	imply CPU_RISCV
	imply RISCV_TIMER if (RISCV_SMODE || SPL_RISCV_SMODE)
	imply ANDES_PLIC if (RISCV_MMODE || SPL_RISCV_MMODE)
	imply ANDES_PLMT if (RISCV_MMODE || SPL_RISCV_MMODE)
	imply SPL_CPU_SUPPORT

if RISCV_PICOCOM

config RISCV_NDS_CACHE
	bool "AndeStar V5 families specific cache support"
	depends on RISCV_MMODE || SPL_RISCV_MMODE

endif
```

## board/picocom/pc805/Kconfig
```kconfig
if TARGET_PICOCOM_PC805

config SYS_CPU
	default "pc805"

config SYS_BOARD
	default "pc805"

config SYS_VENDOR
	default "picocom"

config SYS_SOC
	default "pc805_r0"

config SYS_CONFIG_NAME
	default "pc805"

config ENV_SIZE
	default 0x2000 if ENV_IS_IN_SPI_FLASH

config ENV_OFFSET
	default 0x140000 if ENV_IS_IN_SPI_FLASH

config SPL_TEXT_BASE
	default 0x10104000
	#default 0x10300000

config SPL_OPENSBI_LOAD_ADDR
	default 0x80000000

config BOARD_SPECIFIC_OPTIONS # dummy
	def_bool y
	select RISCV_PICOCOM
	select SUPPORT_SPL
	imply SPL_RAM_SUPPORT
	imply SPL_RAM_DEVICE

config SPL_LPDDR4_ISSI_ECC_ERR_ON
    bool "LPDDR4 ISSI on-chip ecc and error indication enable"
    depends on SPL
    default n

config SPL_LPDDR4_INLINE_ECC_ENABLE
    bool "LPDDR4 enable inline ecc"
    depends on SPL
    default n

config SPL_LPDDR4_TOTAL_SIZE
    int "LPDDR4 size for mega bytes"
    depends on SPL
    default 512

endif
```

## configs/picocom_pc805_rv32_spl_defconfig
```kconfig
CONFIG_RISCV=y
CONFIG_RISCV_MMODE=y
CONFIG_TARGET_PICOCOM_PC805=y
CONFIG_OF_EMBED=y
CONFIG_DEFAULT_DEVICE_TREE="pc805"
CONFIG_SYS_TEXT_BASE=0x90000000
CONFIG_LOG_DEFAULT_LEVEL=7
CONFIG_LOG_ERROR_RETURN=y
CONFIG_ENV_SECT_SIZE=0x1000
CONFIG_DISTRO_DEFAULTS=y
CONFIG_BOOTDELAY=3
CONFIG_BOARD_EARLY_INIT_F=y
CONFIG_MISC_INIT_R=y
CONFIG_SYS_PROMPT="PC805 SPL # "
CONFIG_BOOTP_PREFER_SERVERIP=y
CONFIG_ENV_OVERWRITE=y
CONFIG_BOOTP_SEND_HOSTNAME=y
CONFIG_DM_ETH=y
CONFIG_DM_MDIO=y
CONFIG_DWC_ETH_QOS=y
CONFIG_NET_RANDOM_ETHADDR=y
CONFIG_PHY_SMSC=y
CONFIG_FTSDC010=y
CONFIG_FTSDC010_SDIO=y
CONFIG_MTD=y
CONFIG_DM_MTD=y
CONFIG_FLASH_CFI_DRIVER=y
CONFIG_SYS_FLASH_USE_BUFFER_WRITE=y
CONFIG_SYS_FLASH_CFI=y
CONFIG_SF_DEFAULT_MODE=0x0
CONFIG_SPI=y
CONFIG_DM_SPI=y
CONFIG_DESIGNWARE_SPI=y
CONFIG_MTD_SPI_NAND=y
CONFIG_SPI_FLASH=y
CONFIG_SYS_NS16550=y
CONFIG_SYS_NS16550_IER=0
CONFIG_BAUDRATE=115200
CONFIG_DEBUG_UART=y
CONFIG_DEBUG_UART_NS16550=y
CONFIG_DEBUG_UART_BASE=0x08212000
CONFIG_DEBUG_UART_CLOCK=325000000
CONFIG_DEBUG_UART_SHIFT=2
CONFIG_RISCV_TIMER=y
CONFIG_MKIMAGE_DTC_PATH="${PWD}/scripts/dtc/dtc"
CONFIG_BOARD_LATE_INIT=y
CONFIG_CMD_IMLS=y
CONFIG_CMD_SF=y
CONFIG_CMD_SF_TEST=y
CONFIG_CMD_CACHE=y
CONFIG_CMD_MTD=y
CONFIG_CMD_MTDPARTS=y
CONFIG_FIT=y
CONFIG_SPL=y
CONFIG_SPL_RISCV_MMODE=y
CONFIG_SPL_LOG_MAX_LEVEL=7
CONFIG_SPL_CACHE=y
CONFIG_SPL_CACHE_SUPPORT=y
CONFIG_SPL_LOAD_FIT=y
```
